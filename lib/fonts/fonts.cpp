#include "fonts.h"

Number8x16::Number8x16(Display& display)
: m_display{display}
{
}

void Number8x16::draw_char(char c, int16_t x_start, int16_t y_start)
{
    size_t offset{0};

    if (c >= '0' && c <= '9') {
        offset = c - '0'; // '0' -> ASCI #48
    }
    else if (c == '.') {
        offset = 10;
    }
    else if (c == 'C') {
        offset = 11;
    }
    else if (c == '%') {
        offset = 12;
    }
    else if (c == 'h') {
        offset = 13;
    }
    else if (c == 'm') {
        offset = 14;
    }
    else if (c == 's') {
        offset = 15;
    }
    else if (c == '>') {
        offset = 16;
    }
    else if (c == ':') {
        offset = 17;
    }
    else {
        // skip unknown characters
        return;
    }

    m_display.draw_bitmap(x_start, y_start, Bitmap{8, 16, (const uint8_t*) (NUMBER_8_16 + 16 * (((uint8_t) offset)))});
}

void Number8x16::draw(const char* s, int16_t x, int16_t y, char h_alignment)
{
    int16_t x_char = x;
    uint8_t n_chars = 0;

    for (uint8_t i = 0; s[i] != '\0'; i++) {
        n_chars += 1;
        if (h_alignment == 'l') {
            draw_char(s[i], x_char, y);
        }
        if (s[i + 1] == '.' || s[i] == '.' || s[i + 1] == ' ' || s[i] == ' ' || s[i + 1] == ':' || s[i] == ':') {
            // less horizontal space for '.' and ' '
            x_char += 6; // as decreased by 2 before and after, total width is 4
        }
        else {
            x_char += 8;
        }
    }

    if (h_alignment == 'r') {
        x_char = x;
        for (uint8_t i = n_chars; i > 0; i--) {
            if (s[i] == '.' || s[i - 1] == '.' || s[i] == ' ' || s[i - 1] == ' ' || s[i] == ':' || s[i - 1] == ':') {
                // less horizontal space for '.' and ' '
                x_char -= 6; // as decreased by 2 before and after, total width is 4
            }
            else {
                x_char -= 8;
            }
            draw_char(s[i - 1], x_char, y);
        }
    }
}

Number18x32::Number18x32(Display& display)
: m_display{display}
{
}

void Number18x32::draw_char(char c, int16_t x_start, int16_t y_start)
{
    size_t offset{0};

    if (c >= '0' && c <= '9') {
        offset = c - '0'; // '0' -> ASCI #48
        m_display.draw_bitmap(x_start, y_start, Bitmap{18, 32, DIGITS_18_32[offset]});
    }
    else if (c == '.') {
        offset = 10;
        m_display.draw_bitmap(x_start, y_start + 26, Bitmap{18, 6, DOT_18_6});
    }
    else if (c == ':') {
        m_display.draw_bitmap(x_start, y_start + 5, Bitmap{18, 6, DOT_18_6});
        m_display.draw_bitmap(x_start, y_start + 21, Bitmap{18, 6, DOT_18_6});
    }
    else if (c == '-') {
        m_display.draw_bitmap(x_start, y_start + (int16_t) 14, Bitmap{18, 4, DASH_18_4});
    }
    else if (c == '%') {
        m_display.draw_bitmap(x_start, y_start, Bitmap{19, 22, CHARS_16_22[0]});
    }
    else if (c == 'C') {
        m_display.draw_bitmap(x_start, y_start, Bitmap{19, 22, CHARS_16_22[1]});
    }
    else if (c == '#') {
        m_display.draw_bitmap(x_start, y_start, Bitmap{19, 22, CHARS_16_22[2]});
    }
    else if (c == 'h') {
        m_display.draw_bitmap(x_start, y_start, Bitmap{19, 22, CHARS_16_22[3]});
    }
    else if (c == 'm') {
        m_display.draw_bitmap(x_start, y_start, Bitmap{19, 22, CHARS_16_22[4]});
    }
    else if (c == 's') {
        m_display.draw_bitmap(x_start, y_start, Bitmap{19, 22, CHARS_16_22[5]});
    }
    else {
        // skip unknown characters
        return;
    }
}

void Number18x32::draw(const char* s, int16_t x, int16_t y, char h_alignment)
{
    int16_t x_char = x;
    uint8_t n_chars = 0;

    for (uint8_t i = 0; s[i] != '\0'; i++) {
        n_chars += 1;
        if (h_alignment == 'l') {
            draw_char(s[i], x_char, y);
        }
        if (s[i + 1] == '.' || s[i] == '.' || s[i + 1] == ':' || s[i] == ':') {
            // less horizontal space before and after '.' and ':'
            x_char += 14;
        }
        else if (s[i] == ' ') {
            // less horizontal space for ' '
            x_char += 8;
        }
        else if (s[i] == 'C' || s[i] == '%' || s[i] == '#' || s[i] == 'h' || s[i] == 'm' || s[i] == 's') {
            // different horizontal space for units, most 16px except for 'm' 19px
            x_char += 19;
        }
        else {
            x_char += 20;
        }
    }

    if (h_alignment == 'c') {
        x_char = -(x_char - x) / 2;
        for (uint8_t i = 0; i < n_chars; i++) {
            draw_char(s[i], x + x_char, y);
            if (s[i + 1] == '.' || s[i] == '.' || s[i + 1] == ':' || s[i] == ':') {
                // less horizontal space for '.' and ':'
                x_char += 14;
            }
            else if (s[i] == ' ') {
                // less horizontal space for ' '
                x_char += 8;
            }
            else if (s[i] == 'C' || s[i] == '%' || s[i] == '#' || s[i] == 'h' || s[i] == 'm' || s[i] == 's') {
                // different horizontal space for units, most 16px except for 'm' 19px
                x_char += 19;
            }
            else {
                x_char += 20;
            }
        }
        return;
    }

    if (h_alignment == 'r') {
        x_char = x;
        for (uint8_t i = n_chars; i > 0; i--) {
            if (s[i] == '.' || s[i - 1] == '.' || s[i] == ':' || s[i - 1] == ':') {
                // less horizontal space for '.' and ':'
                x_char -= 14;
            }
            else if (s[i] == ' ') {
                // less horizontal space for ' '
                x_char -= 8;
            }
            else if (s[i] == 'C' || s[i] == '%' || s[i] == '#' || s[i] == 'h' || s[i] == 'm' || s[i] == 's') {
                // different horizontal space for units, most 16px except for 'm' 19px
                x_char -= 19;
            }
            else {
                x_char -= 20;
            }
            draw_char(s[i - 1], x_char, y);
        }
    }
}

// clang-format off

const PROGMEM uint8_t NUMBER_8_16[288] = {
    0x00, 0x00, 0x18, 0x24, 0x42, 0x42, 0x42, 0x42, 0x42, 0x42, 0x24, 0x18, 0x00, 0x00, 0x00, 0x00, // 0
    0x00, 0x00, 0x08, 0x18, 0x28, 0x08, 0x08, 0x08, 0x08, 0x08, 0x08, 0x08, 0x00, 0x00, 0x00, 0x00, // 1
    0x00, 0x00, 0x3c, 0x42, 0x42, 0x02, 0x04, 0x08, 0x10, 0x20, 0x40, 0x7e, 0x00, 0x00, 0x00, 0x00, // 2
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    0x00, 0x00, 0x00, 0x00, 0x00, 0x18, 0x18, 0x00, 0x00, 0x18, 0x18, 0x00, 0x00, 0x00, 0x00, 0x00, // :
    // TODO '-'
};

const PROGMEM uint8_t DASH_18_4[12] = {
    0x1f, 0xfc, 0x00,
    0x1f, 0xfc, 0x00,
    0x1f, 0xfc, 0x00,
    0x1f, 0xfc, 0x00,
};

const PROGMEM uint8_t DOT_18_6[18] = {
    0x01, 0xc0, 0x00,
    0x03, 0xe0, 0x00,
    0x03, 0xe0, 0x00,
    0x03, 0xe0, 0x00,
    0x03, 0xe0, 0x00,
    0x01, 0xc0, 0x00,
};

const PROGMEM uint8_t DIGITS_18_32[10][96] = {
    {
        0x03, 0xe0, 0x00, 0x0f, 0xf8, 0x00, 0x1f, 0xfc,
        0x00, 0x3c, 0x1e, 0x00, 0x38, 0x0e, 0x00, 0x78,
        0x0f, 0x00, 0x70, 0x07, 0x00, 0x70, 0x07, 0x00,
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        0xfc, 0x00, 0x0f, 0xf8, 0x00, 0x03, 0xe0, 0x00,
    },
    {
        0x00, 0xf0, 0x00, 0x01, 0xf0, 0x00, 0x03, 0xf0,
        0x00, 0x0e, 0xf0, 0x00, 0x7e, 0xf0, 0x00, 0x7c,
        0xf0, 0x00, 0x70, 0xf0, 0x00, 0x00, 0xf0, 0x00,
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        0xff, 0xc0, 0x3f, 0xff, 0xc0, 0x3f, 0xff, 0xc0,
    },
    {
        0x07, 0xf0, 0x00, 0x1f, 0xfc, 0x00, 0x3f, 0xfe,
        0x00, 0x3c, 0x1f, 0x00, 0x78, 0x0f, 0x00, 0x78,
        0x0f, 0x00, 0x78, 0x07, 0x00, 0x70, 0x07, 0x00,
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        0xff, 0x80, 0xff, 0xff, 0x80, 0xff, 0xff, 0x80,
    },
    {
        0x07, 0xf0, 0x00, 0x1f, 0xfc, 0x00, 0x3f, 0xfe,
        0x00, 0x7c, 0x1e, 0x00, 0x78, 0x0f, 0x00, 0x78,
        0x0f, 0x00, 0x70, 0x07, 0x00, 0x70, 0x07, 0x00,
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        0xfe, 0x00, 0x1f, 0xfc, 0x00, 0x0f, 0xf0, 0x00,
    },
    {
        0x00, 0x7e, 0x00, 0x00, 0x7e, 0x00, 0x00, 0xfe,
        0x00, 0x00, 0xfe, 0x00, 0x01, 0xfe, 0x00, 0x01,
        0xfe, 0x00, 0x03, 0xde, 0x00, 0x03, 0xde, 0x00,
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        0x1e, 0x00, 0x00, 0x1e, 0x00, 0x00, 0x1e, 0x00,
    },
    {
        0x7f, 0xff, 0x00, 0x7f, 0xff, 0x00, 0x7f, 0xff,
        0x00, 0x70, 0x00, 0x00, 0x70, 0x00, 0x00, 0x70,
        0x00, 0x00, 0x70, 0x00, 0x00, 0x70, 0x00, 0x00,
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        0xfe, 0x00, 0x3f, 0xfc, 0x00, 0x0f, 0xf0, 0x00,
    },
    {
        0x07, 0xf0, 0x00, 0x1f, 0xfc, 0x00, 0x3f, 0xfe,
        0x00, 0x3c, 0x1e, 0x00, 0x78, 0x0f, 0x00, 0x78,
        0x0f, 0x00, 0x70, 0x0f, 0x00, 0xf0, 0x07, 0x00,
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        0xfe, 0x00, 0x0f, 0xfc, 0x00, 0x07, 0xf0, 0x00,
    },
    {
        0xff, 0xff, 0x80, 0xff, 0xff, 0x80, 0xff, 0xff,
        0x80, 0x00, 0x07, 0x80, 0x00, 0x0f, 0x00, 0x00,
        0x0f, 0x00, 0x00, 0x1e, 0x00, 0x00, 0x1e, 0x00,
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        0x80, 0x00, 0x07, 0x80, 0x00, 0x07, 0x80, 0x00,
    },
    {
        0x07, 0xf0, 0x00, 0x1f, 0xfc, 0x00, 0x3f, 0xfe,
        0x00, 0x7c, 0x1e, 0x00, 0x78, 0x0f, 0x00, 0x78,
        0x0f, 0x00, 0x78, 0x0f, 0x00, 0x70, 0x07, 0x00,
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        0xfe, 0x00, 0x1f, 0xfc, 0x00, 0x07, 0xf0, 0x00,
    },
    {
        0x07, 0xf0, 0x00, 0x1f, 0xf8, 0x00, 0x3f, 0xfc,
        0x00, 0x3c, 0x1e, 0x00, 0x78, 0x0f, 0x00, 0x78,
        0x07, 0x00, 0xf0, 0x07, 0x00, 0xf0, 0x07, 0x80,
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        0xfe, 0x00, 0x1f, 0xf8, 0x00, 0x07, 0xf0, 0x00,
    }
};

// Characters '%', 'C' 'g/m^3', 'h', 'm', 's'
const PROGMEM uint8_t CHARS_16_22[6][66] = {
    {   // '%', 16x22px
        0x3c, 0x06, 0x00, 0x7e, 0x0e, 0x00, 0xe7, 0x0c, 0x00, 0xc3, 0x18, 0x00,
        0xc3, 0x18, 0x00, 0xc3, 0x30, 0x00, 0xe7, 0x70, 0x00, 0x7e, 0x60, 0x00,
        0x3c, 0xe0, 0x00, 0x00, 0xc0, 0x00, 0x01, 0x80, 0x00, 0x01, 0x80, 0x00,
        0x03, 0x00, 0x00, 0x07, 0x3c, 0x00, 0x06, 0x7e, 0x00, 0x0e, 0xe7, 0x00,
        0x0c, 0xc3, 0x00, 0x18, 0xc3, 0x00, 0x18, 0xc3, 0x00, 0x30, 0xe7, 0x00,
        0x70, 0x7e, 0x00, 0x60, 0x3c, 0x00,
    },
    {   // 'C', 16x22px
        0x07, 0xe0, 0x00, 0x0f, 0xf8, 0x00, 0x1f, 0xfc, 0x00, 0x3f, 0xfe, 0x00,
        0x3c, 0x1e, 0x00, 0x78, 0x0c, 0x00, 0x78, 0x00, 0x00, 0x70, 0x00, 0x00,
	    0xf0, 0x00, 0x00, 0xf0, 0x00, 0x00, 0xf0, 0x00, 0x00, 0xf0, 0x00, 0x00,
        0xf0, 0x00, 0x00, 0xf0, 0x00, 0x00, 0x70, 0x00, 0x00, 0x78, 0x00, 0x00,
	    0x78, 0x0c, 0x00, 0x3c, 0x1e, 0x00, 0x3f, 0xfe, 0x00, 0x1f, 0xfc, 0x00,
        0x0f, 0xf8, 0x00, 0x07, 0xe0, 0x00,
    },
    {   // 'g/m^3', 16x22px
        0x3a, 0x00, 0x00, 0x6e, 0x00, 0x00, 0x6c, 0x00, 0x00, 0x6c, 0x00, 0x00,
        0x38, 0x00, 0x00, 0x20, 0x00, 0x00, 0x7c, 0x03, 0x00, 0x66, 0x0f, 0x00,
        0x3c, 0x3c, 0x00, 0x00, 0xf0, 0x00, 0x03, 0xc7, 0x00, 0x0f, 0x01, 0x00,
        0x3c, 0x03, 0x00, 0xf0, 0x01, 0x00, 0xc0, 0x07, 0x00, 0x06, 0xf0, 0x00,
        0x07, 0xf8, 0x00, 0x06, 0xd8, 0x00, 0x06, 0xd8, 0x00, 0x06, 0xd8, 0x00,
        0x06, 0xd8, 0x00, 0x06, 0xd8, 0x00,
    },
    {   // 'h', 16x22px
        0xe0, 0x00, 0x00, 0xe0, 0x00, 0x00, 0xe0, 0x00, 0x00, 0xe0, 0x00, 0x00,
        0xe0, 0x00, 0x00, 0xe0, 0x00, 0x00, 0xff, 0x00, 0x00, 0xff, 0x80, 0x00,
        0xff, 0xc0, 0x00, 0xf1, 0xe0, 0x00, 0xe0, 0xe0, 0x00, 0xe0, 0xe0, 0x00,
        0xe0, 0xe0, 0x00, 0xe0, 0xe0, 0x00, 0xe0, 0xe0, 0x00, 0xe0, 0xe0, 0x00,
        0xe0, 0xe0, 0x00, 0xe0, 0xe0, 0x00, 0xe0, 0xe0, 0x00, 0xe0, 0xe0, 0x00,
        0xe0, 0xe0, 0x00, 0xe0, 0xe0, 0x00, 
    },
    {   // 'm', 19x22px
        0x00, 0x00, 0x00, 0x00, 0x00, 0x00, 0x00, 0x00, 0x00, 0x00, 0x00, 0x00,
        0x00, 0x00, 0x00, 0x00, 0x00, 0x00, 0xff, 0x1f, 0x00, 0xff, 0xbf, 0x80,
        0xff, 0xff, 0xc0, 0xe1, 0xe1, 0xc0, 0xe0, 0xe0, 0xe0, 0xe0, 0xe0, 0xe0,
        0xe0, 0xe0, 0xe0, 0xe0, 0xe0, 0xe0, 0xe0, 0xe0, 0xe0, 0xe0, 0xe0, 0xe0,
        0xe0, 0xe0, 0xe0, 0xe0, 0xe0, 0xe0, 0xe0, 0xe0, 0xe0, 0xe0, 0xe0, 0xe0,
        0xe0, 0xe0, 0xe0, 0xe0, 0xe0, 0xe0,
    },
    {   // 's', 16x22px
        0x00, 0x00, 0x00, 0x00, 0x00, 0x00, 0x00, 0x00, 0x00, 0x00, 0x00, 0x00,
        0x00, 0x00, 0x00, 0x1e, 0x00, 0x00, 0x7f, 0x00, 0x00, 0x7f, 0x80, 0x00,
        0xe3, 0xc0, 0x00, 0xe1, 0xc0, 0x00, 0xe1, 0xc0, 0x00, 0xf0, 0x00, 0x00,
        0x7e, 0x00, 0x00, 0x3f, 0x00, 0x00, 0x1f, 0x80, 0x00, 0x03, 0xc0, 0x00,
        0xe1, 0xc0, 0x00, 0xe1, 0xc0, 0x00, 0xe3, 0xc0, 0x00, 0x7f, 0x80, 0x00,
        0x7f, 0x00, 0x00, 0x1e, 0x00, 0x00,
    }
};

// clang-format on
